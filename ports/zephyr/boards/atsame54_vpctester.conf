## ports/zephyr/boards/atsame54_vpctester.conf
```kconfig
##### TOTAL RAM SIZE: 256kB #####

CONFIG_MICROPY_HEAP_SIZE=131072
# set stack sizes for system threads
CONFIG_MAIN_STACK_SIZE=32608
CONFIG_NET_TX_STACK_SIZE=16304
CONFIG_NET_RX_STACK_SIZE=16304
CONFIG_NET_BUF_DATA_SIZE=256

# enable flash drivers
CONFIG_FLASH=y
CONFIG_FLASH_MAP=y
CONFIG_MPU_ALLOW_FLASH_WRITE=y

# Hardware features
CONFIG_I2C=y
CONFIG_SPI=y
```
